## split-ergo60pct-akdk/boards/shields/split_ergo60pct/Kconfig.defconfig
```kconfig
if SHIELD_SPLIT_ERGO60PCT_LEFT

config ZMK_KEYBOARD_NAME
    default "split_ergo60pct"

endif

if SHIELD_SPLIT_ERGO60PCT_LEFT || SHIELD_SPLIT_ERGO60PCT_RIGHT

config ZMK_SPLIT
    default y

endif
```

## split-ergo60pct-akdk/boards/shields/split_ergo60pct/Kconfig.shield
```kconfig
config SHIELD_SPLIT_ERGO60PCT_LEFT
    def_bool $(shields_list_contains,split_ergo60pct_left)
config SHIELD_SPLIT_ERGO60PCT_RIGHT
    def_bool $(shields_list_contains,split_ergo60pct_right)
```
